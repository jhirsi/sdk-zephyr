## drivers/ethernet/Kconfig.w5500
```kconfig
# W5500 Ethernet driver configuration options

# Copyright (c) 2020 Linumiz
# Author: Parthiban Nallathambi <parthiban@linumiz.com>
# SPDX-License-Identifier: Apache-2.0

menuconfig ETH_W5500
	bool "W5500 Ethernet Controller"
	default y
	depends on DT_HAS_WIZNET_W5500_ENABLED
	select SPI
	help
	  W5500 Stand-Alone Ethernet Controller
	  with SPI Interface

config ETH_W5500_RX_THREAD_STACK_SIZE
	int "Stack size for internal incoming packet handler"
	depends on ETH_W5500
	default 1024
	help
	  Size of the stack used for internal thread which is ran for
	  incoming packet processing.

config ETH_W5500_RX_THREAD_PRIO
	int "Priority for internal incoming packet handler"
	depends on ETH_W5500
	default 2
	help
	  Priority level for internal thread which is ran for incoming
	  packet processing.

config ETH_W5500_TIMEOUT
	int "IP buffer timeout"
	depends on ETH_W5500
	default 100
	help
	  Given timeout in milliseconds. Maximum amount of time
	  that the driver will wait from the IP stack to get
	  a memory buffer before the Ethernet frame is dropped.

config ETH_W5500_MONITOR_PERIOD
	int "Monitor task execution period"
	depends on ETH_W5500
	default 500
	help
	  Monitor task execution period in milliseconds. The monitor task is
	  periodically executed to detect and report any changes in the
	  link status to the operating system.

config ETH_W5500_POLL_PERIOD
	int "W5500 polling period in milliseconds"
	depends on ETH_W5500
	default 10
	help
	  Polling interval in milliseconds for RX data and link status
	  when operating in polling mode (no int-gpios defined in
	  devicetree).

config ETH_W5500_TX_SEM_TIMEOUT_MS
	int "TX semaphore wait timeout in milliseconds"
	depends on ETH_W5500
	default 10
	range 1 1000
	help
	  Maximum time w5500_tx() waits for SENDOK before failing the
	  transmit in interrupt mode. In devicetree polling mode (no
	  int-gpios) the driver instead busy-waits on S0_IR from the TX
	  path using the same timeout, blocking the calling thread's CPU
	  for the whole duration on a stalled link; keep this value small
	  in that mode.

choice ETH_W5500_PHY_SPEED
	prompt "W5500 PHY speed/duplex mode"
	depends on ETH_W5500
	default ETH_W5500_PHY_SPEED_AUTO
	help
	  Selects the W5500 internal PHY operating mode written to PHYCFGR
	  (OPMD/OPMDC) at driver init.

	  Default is auto-negotiation (all-capable), matching the chip reset
	  default. The forced modes disable auto-negotiation and lock the PHY
	  to a fixed speed/duplex; in that case configure the link partner to
	  the same fixed setting to avoid a duplex mismatch.

config ETH_W5500_PHY_SPEED_AUTO
	bool "Auto-negotiation (all-capable)"

config ETH_W5500_PHY_SPEED_10BT_HD
	bool "10BASE-T half-duplex (forced, AN disabled)"

config ETH_W5500_PHY_SPEED_10BT_FD
	bool "10BASE-T full-duplex (forced, AN disabled)"

config ETH_W5500_PHY_SPEED_100BT_HD
	bool "100BASE-T half-duplex (forced, AN disabled)"

config ETH_W5500_PHY_SPEED_100BT_FD
	bool "100BASE-T full-duplex (forced, AN disabled)"

endchoice
```

## samples/bluetooth/scan_adv/boards/nrf9160dk_nrf9160_ns.conf
```kconfig
CONFIG_BT_H4=y
CONFIG_BT_WAIT_NOP=y

CONFIG_UART_INTERRUPT_DRIVEN=y
CONFIG_NRF_SW_LPUART=y
CONFIG_NRF_SW_LPUART_INT_DRIVEN=y
CONFIG_UART_2_ASYNC=y
CONFIG_UART_2_INTERRUPT_DRIVEN=n
CONFIG_UART_2_NRF_HW_ASYNC=y
CONFIG_UART_2_NRF_HW_ASYNC_TIMER=2

CONFIG_BT_HCI=y
CONFIG_BT_HCI_ACL_FLOW_CONTROL=y
```
