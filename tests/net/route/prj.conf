## prj.conf
```kconfig
CONFIG_NETWORKING=y
CONFIG_NET_TEST=y
CONFIG_NET_IPV6=y
CONFIG_NET_UDP=y
CONFIG_NET_TCP=n
CONFIG_NET_IPV4=n
CONFIG_NET_MAX_CONTEXTS=4
CONFIG_NET_L2_DUMMY=y
CONFIG_NET_L2_ETHERNET=y
CONFIG_ETH_DRIVER=n
CONFIG_ASSERT=y
CONFIG_NET_IPV6_ND=n
CONFIG_NET_LOG=y
CONFIG_ENTROPY_GENERATOR=y
CONFIG_TEST_RANDOM_GENERATOR=y
CONFIG_NET_IPV6_DAD=n
CONFIG_NET_IPV6_MLD=n
CONFIG_NET_PKT_TX_COUNT=10
CONFIG_NET_PKT_RX_COUNT=5
CONFIG_NET_BUF_RX_COUNT=5
CONFIG_NET_BUF_TX_COUNT=5
CONFIG_NET_IF_UNICAST_IPV6_ADDR_COUNT=6
CONFIG_NET_IF_MAX_IPV6_COUNT=3
CONFIG_NET_MAX_ROUTES=4
CONFIG_NET_MAX_NEXTHOPS=8
CONFIG_NET_IPV6_MAX_NEIGHBORS=8
CONFIG_ZTEST=y
```

## src/main.c
```c
/* main.c - Application main entry point */

/*
 * Copyright (c) 2016 Intel Corporation
 *
 * SPDX-License-Identifier: Apache-2.0
 */

#include <zephyr/logging/log.h>
LOG_MODULE_REGISTER(net_test, CONFIG_NET_ROUTE_LOG_LEVEL);

#include <zephyr/types.h>
#include <zephyr/ztest.h>
#include <stdbool.h>
#include <stddef.h>
#include <string.h>
#include <errno.h>
#include <zephyr/sys/printk.h>
#include <zephyr/linker/sections.h>
#include <zephyr/random/random.h>

#include <zephyr/tc_util.h>

#include <zephyr/net/ethernet.h>
#include <zephyr/net/dummy.h>
#include <zephyr/net_buf.h>
#include <zephyr/net/net_ip.h>
#include <zephyr/net/net_if.h>
#include <zephyr/net/net_context.h>

#define NET_LOG_ENABLED 1
#include "net_private.h"
#include "icmpv6.h"
#include "ipv6.h"
#include "nbr.h"
#include "route.h"

#if defined(CONFIG_NET_ROUTE_LOG_LEVEL_DBG)
#define DBG(fmt, ...) printk(fmt, ##__VA_ARGS__)
#else
#define DBG(fmt, ...)
#endif

static struct net_context *udp_ctx;

/* Interface 1 is the default host and it has my_addr assigned to it */
static struct net_in6_addr my_addr = { { { 0x20, 0x01, 0x0d, 0xb8, 0, 0, 0, 0,
					  0, 0, 0, 0, 0, 0, 0, 0x1 } } };

/* Interface 2 is the secondary host for peer device with address peer_addr */
static struct net_in6_addr peer_addr = { { { 0x20, 0x01, 0x0d, 0xb8, 0, 0, 0, 0,
				    0, 0, 0, 0, 0x0b, 0x0e, 0x0e, 0x3 } } };

/* Alternate next hop address for dest_addr */
static struct net_in6_addr peer_addr_alt = { { { 0x20, 0x01, 0x0d, 0xb8, 0, 0, 0, 0,
				    0, 0, 0, 0, 0x0b, 0x0e, 0x0e, 0x4 } } };

/* The dest_addr is only reachable via peer_addr */
static struct net_in6_addr dest_addr = { { { 0x20, 0x01, 0x0d, 0xb8, 0, 0, 0, 0,
					 0, 0, 0, 0, 0xd, 0xe, 0x5, 0x7 } } };

/* Extra address is assigned to ll_addr */
static struct net_in6_addr ll_addr = { { { 0xfe, 0x80, 0x43, 0xb8, 0, 0, 0, 0,
				       0, 0, 0, 0xf2, 0xaa, 0x29, 0x02,
				       0x04 } } };

static struct net_in6_addr in6addr_mcast = { { { 0x20, 0x01, 0x0d, 0xb8, 0, 0, 0, 0,
					     0, 0, 0, 0, 0, 0, 0, 0x1 } } };

/* Generic address that we are using to generate some more addresses */
static struct net_in6_addr generic_addr = { { { 0x20, 0x01, 0x0d, 0xb8, 0, 0, 0, 0,
					    0, 0, 0, 0, 0xbe, 0xef, 0, 0 } } };

static struct net_if *recipient;
static struct net_if *my_iface;
static struct net_if *peer_iface;

static struct net_route_entry *route_entry;

#define MAX_ROUTES CONFIG_NET_MAX_ROUTES
static const int max_routes = MAX_ROUTES;
static struct net_route_entry *test_routes[MAX_ROUTES];
static struct net_in6_addr dest_addresses[MAX_ROUTES];

static bool test_failed;
static bool data_failure;
static bool feed_data; /* feed data back to IP stack */

static int msg_sending;

K_SEM_DEFINE(wait_data, 0, UINT_MAX);

#define WAIT_TIME K_MSEC(250)

struct net_route_test {
	uint8_t mac_addr[sizeof(struct net_eth_addr)];
	struct net_linkaddr ll_addr;
};

int net_route_dev_init(const struct device *dev)
{
	return 0;
}

static uint8_t *net_route_get_mac(const struct device *dev)
{
	struct net_route_test *route = dev->data;

	if (route->mac_addr[2] == 0x00) {
		/* 00-00-5E-00-53-xx Documentation RFC 7042 */
		route->mac_addr[0] = 0x00;
		route->mac_addr[1] = 0x00;
		route->mac_addr[2] = 0x5E;
		route->mac_addr[3] = 0x00;
		route->mac_addr[4] = 0x53;
		route->mac_addr[5] = sys_rand8_get();
	}

	memcpy(route->ll_addr.addr, route->mac_addr, sizeof(route->mac_addr));
	route->ll_addr.len = sizeof(route->mac_addr);

	return route->mac_addr;
}

static void net_route_iface_init(struct net_if *iface)
{
	uint8_t *mac = net_route_get_mac(net_if_get_device(iface));

	net_if_set_link_addr(iface, mac, sizeof(struct net_eth_addr),
			     NET_LINK_ETHERNET);
}

static int tester_send(const struct device *dev, struct net_pkt *pkt)
{
	if (!pkt->frags) {
		TC_ERROR("No data to send!\n");
		return -ENODATA;
	}

	/* By default we assume that the test is ok */
	data_failure = false;

	if (feed_data) {
		DBG("Received at iface %p and feeding it into iface %p\n",
		    net_pkt_iface(pkt), recipient);

		net_pkt_ref(pkt);

		if (net_recv_data(recipient, pkt) < 0) {
			TC_ERROR("Data receive failed.");
			net_pkt_unref(pkt);
			test_failed = true;
		}

		goto out;
	}

	DBG("pkt %p to be sent len %lu\n", pkt, net_pkt_get_len(pkt));

	if (data_failure) {
		test_failed = true;
	}

	msg_sending = 0;
out:
	k_sem_give(&wait_data);

	return 0;
}

static int tester_send_peer(const struct device *dev, struct net_pkt *pkt)
{
	if (!pkt->frags) {
		TC_ERROR("No data to send!\n");
		return -ENODATA;
	}

	/* By default we assume that the test is ok */
	data_failure = false;

	if (feed_data) {
		DBG("Received at iface %p and feeding it into iface %p\n",
		    net_pkt_iface(pkt), recipient);

		net_pkt_ref(pkt);
		if (net_recv_data(recipient, pkt) < 0) {
			TC_ERROR("Data receive failed.");
			net_pkt_unref(pkt);
			test_failed = true;
		}

		goto out;
	}

	DBG("pkt %p to be sent len %lu\n", pkt, net_pkt_get_len(pkt));

	if (data_failure) {
		test_failed = true;
	}

	msg_sending = 0;
out:
	k_sem_give(&wait_data);

	return 0;
}

struct net_route_test net_route_data;
struct net_route_test net_route_data_peer;

static struct dummy_api net_route_if_api = {
	.iface_api.init = net_route_iface_init,
	.send = tester_send,
};

static struct dummy_api net_route_if_api_peer = {
	.iface_api.init = net_route_iface_init,
	.send = tester_send_peer,
};

#define _ETH_L2_LAYER DUMMY_L2
#define _ETH_L2_CTX_TYPE NET_L2_GET_CTX_TYPE(DUMMY_L2)

NET_DEVICE_INIT_INSTANCE(net_route_test, "net_route_test", host,
			 net_route_dev_init, NULL,
			 &net_route_data, NULL,
			 CONFIG_KERNEL_INIT_PRIORITY_DEFAULT,
			 &net_route_if_api, _ETH_L2_LAYER,
			 _ETH_L2_CTX_TYPE, 127);

NET_DEVICE_INIT_INSTANCE(net_route_test_peer, "net_route_test_peer", peer,
			 net_route_dev_init, NULL,
			 &net_route_data_peer, NULL,
			 CONFIG_KERNEL_INIT_PRIORITY_DEFAULT,
			 &net_route_if_api_peer, _ETH_L2_LAYER,
			 _ETH_L2_CTX_TYPE, 127);

static void test_init(void)
{
	struct net_if_mcast_addr *maddr;
	struct net_if_addr *ifaddr;
	int i;

	my_iface = net_if_get_first_by_type(&NET_L2_GET_NAME(DUMMY));
	peer_iface = net_if_get_first_by_type(&NET_L2_GET_NAME(DUMMY)) + 1;

	DBG("Interfaces: [%d] my %p, [%d] peer %p\n",
	    net_if_get_by_iface(my_iface), my_iface,
	    net_if_get_by_iface(peer_iface), peer_iface);

	zassert_not_null(my_iface,
			 "Interface is NULL");

	zassert_not_null(peer_iface,
			 "Interface is NULL");

	ifaddr = net_if_ipv6_addr_add(my_iface, &my_addr,
				      NET_ADDR_MANUAL, 0);
	zassert_not_null(ifaddr,
			 "Cannot add IPv6 address");

	/* For testing purposes we need to set the addresses preferred */
	ifaddr->addr_state = NET_ADDR_PREFERRED;

	ifaddr = net_if_ipv6_addr_add(my_iface, &ll_addr,
				      NET_ADDR_MANUAL, 0);
	zassert_not_null(ifaddr,
			 "Cannot add IPv6 address");

	ifaddr->addr_state = NET_ADDR_PREFERRED;

	net_ipv6_addr_create(&in6addr_mcast, 0xff02, 0, 0, 0, 0, 0, 0, 0x0001);

	maddr = net_if_ipv6_maddr_add(my_iface, &in6addr_mcast);
	zassert_not_null(maddr,
			 "Cannot add multicast IPv6 address");

	/* The peer and dest interfaces are just simulated, they are not
	 * really used so we should not add IP addresses for them.
	 */

	/* Some test addresses are generated */
	for (i = 0; i < max_routes; i++) {
		memcpy(&dest_addresses[i], &generic_addr,
		       sizeof(struct net_in6_addr));

		dest_addresses[i].s6_addr[14] = i + 1;
		dest_addresses[i].s6_addr[15] = sys_rand8_get();
	}
}

static void test_net_ctx_create(void)
{
	int ret;

	ret = net_context_get(NET_AF_INET6, NET_SOCK_DGRAM, NET_IPPROTO_UDP,
			      &udp_ctx);
	zassert_equal(ret, 0,
		      "Context create IPv6 UDP test failed");
}

static bool net_test_send_ns(struct net_if *iface,
			     struct net_in6_addr *addr)
{
	int ret;

	ret = net_ipv6_send_ns(iface,
			       NULL,
			       addr,
			       &my_addr,
			       &my_addr,
			       false);
	if (ret < 0) {
		TC_ERROR("Cannot send NS (%d)\n", ret);
		return false;
	}

	return true;
}

static bool net_test_nbr_lookup_ok(struct net_if *iface,
				   struct net_in6_addr *addr)
{
	struct net_nbr *nbr;

	nbr = net_ipv6_nbr_lookup(iface, addr);
	if (!nbr) {
		TC_ERROR("Neighbor %s not found in cache\n",
			 net_sprint_ipv6_addr(addr));
		return false;
	}

	return true;
}

static void test_populate_nbr_cache(void)
{
	struct net_nbr *nbr;

	msg_sending = NET_ICMPV6_NS;
	feed_data = true;
	data_failure = false;

	recipient = my_iface;

	zassert_true(net_test_send_ns(peer_iface, &peer_addr));

	nbr = net_ipv6_nbr_add(net_if_get_first_by_type(&NET_L2_GET_NAME(DUMMY)),
			       &peer_addr,
			       &net_route_data_peer.ll_addr,
			       false,
			       NET_IPV6_NBR_STATE_REACHABLE);
	zassert_not_null(nbr, "Cannot add peer to neighbor cache");

	zassert_true(net_test_send_ns(peer_iface, &peer_addr_alt));

	nbr = net_ipv6_nbr_add(net_if_get_first_by_type(&NET_L2_GET_NAME(DUMMY)),
			       &peer_addr_alt,
			       &net_route_data_peer.ll_addr,
			       false,
			       NET_IPV6_NBR_STATE_REACHABLE);
	zassert_not_null(nbr, "Cannot add peer to neighbor cache");

	k_sem_take(&wait_data, WAIT_TIME);

	feed_data = false;

	zassert_false(data_failure, "data failure");

	data_failure = false;

	zassert_true(net_test_nbr_lookup_ok(my_iface, &peer_addr));
}

static void test_route_add(void)
{
	route_entry = net_route_add(my_iface,
				    &dest_addr, 128,
				    &peer_addr,
				    NET_IPV6_ND_INFINITE_LIFETIME,
				    NET_ROUTE_PREFERENCE_LOW);

	zassert_not_null(route_entry, "Route add failed");
}

static void test_route_update(void)
{
	struct net_route_entry *update_entry;

	update_entry = net_route_add(my_iface,
				     &dest_addr, 128,
				     &peer_addr,
				     NET_IPV6_ND_INFINITE_LIFETIME,
				     NET_ROUTE_PREFERENCE_LOW);
	zassert_equal_ptr(update_entry, route_entry,
			  "Route add again failed");
}

static void test_route_del(void)
{
	int ret;

	ret = net_route_del(route_entry);
	if (ret < 0) {
		zassert_true(0, "Route del failed");
	}
}

static void test_route_del_again(void)
{
	int ret;

	ret = net_route_del(route_entry);
	if (ret >= 0) {
		zassert_true(0, "Route del again failed");
	}
}

static void test_route_get_nexthop(void)
{
	struct net_in6_addr *nexthop;

	nexthop = net_route_get_nexthop(route_entry);

	zassert_not_null(nexthop, "Route get nexthop failed");

	zassert_true(net_ipv6_addr_cmp(nexthop, &peer_addr),
		     "Route nexthop does not match");
}

static void test_route_lookup_ok(void)
{
	struct net_route_entry *entry;

	entry = net_route_lookup(my_iface, &dest_addr);
	zassert_not_null(entry,
			 "Route lookup failed");
}

static void test_route_lookup_fail(void)
{
	struct net_route_entry *entry;

	entry = net_route_lookup(my_iface, &peer_addr);
	zassert_is_null(entry,
			"Route lookup failed for peer address");
}

static void test_route_del_nexthop(void)
{
	struct net_in6_addr *nexthop = &peer_addr;
	int ret;

	ret = net_route_del_by_nexthop(my_iface, nexthop);
	zassert_false((ret <= 0), "Route del nexthop failed");
}

static void test_route_del_nexthop_again(void)
{
	struct net_in6_addr *nexthop = &peer_addr;
	int ret;

	ret = net_route_del_by_nexthop(my_iface, nexthop);
	zassert_false((ret >= 0), "Route del again nexthop failed");
}

static void test_route_add_many(void)
{
	int i;

	for (i = 0; i < max_routes; i++) {
		DBG("Adding route %d addr %s\n", i + 1,
		    net_sprint_ipv6_addr(&dest_addresses[i]));
		test_routes[i] = net_route_add(my_iface,
					  &dest_addresses[i], 128,
					  &peer_addr,
					  NET_IPV6_ND_INFINITE_LIFETIME,
					  NET_ROUTE_PREFERENCE_LOW);
		zassert_not_null(test_routes[i], "Route add failed");
		}
}

static void test_route_del_many(void)
{
	int i;

	for (i = 0; i < max_routes; i++) {
		DBG("Deleting route %d addr %s\n", i + 1,
		    net_sprint_ipv6_addr(&dest_addresses[i]));
		zassert_false(net_route_del(test_routes[i]),
			      " Route del failed");
	}
}

static void test_route_lifetime(void)
{
	route_entry = net_route_add(my_iface,
				    &dest_addr, 128,
				    &peer_addr,
				    NET_IPV6_ND_INFINITE_LIFETIME,
				    NET_ROUTE_PREFERENCE_LOW);

	zassert_not_null(route_entry, "Route add failed");

	route_entry = net_route_lookup(my_iface, &dest_addr);
	zassert_not_null(route_entry, "Route not found");

	net_route_update_lifetime(route_entry, 1);

	k_sleep(K_MSEC(1200));

	route_entry = net_route_lookup(my_iface, &dest_addr);
	zassert_is_null(route_entry, "Route did not expire");

}

static void test_route_preference(void)
{
	struct net_route_entry *update_entry;

	route_entry = net_route_add(my_iface,
				    &dest_addr, 128,
				    &peer_addr,
				    NET_IPV6_ND_INFINITE_LIFETIME,
				    NET_ROUTE_PREFERENCE_LOW);
	zassert_not_null(route_entry, "Route add failed");

	update_entry = net_route_add(my_iface,
				     &dest_addr, 128,
				     &peer_addr_alt,
				     NET_IPV6_ND_INFINITE_LIFETIME,
				     NET_ROUTE_PREFERENCE_MEDIUM);
	zassert_equal_ptr(update_entry, route_entry,
			  "Route add again failed");

	update_entry = net_route_add(my_iface,
				     &dest_addr, 128,
				     &peer_addr,
				     NET_IPV6_ND_INFINITE_LIFETIME,
				     NET_ROUTE_PREFERENCE_LOW);
	zassert_is_null(update_entry,
			"Low preference route overwritten medium one");

	net_route_del(route_entry);
}


/*test case main entry*/
ZTEST(route_test_suite, test_route)
{
	test_init();
	test_net_ctx_create();
	test_populate_nbr_cache();
	test_route_add();
	test_route_update();
	test_route_get_nexthop();
	test_route_lookup_ok();
	test_route_lookup_fail();
	test_route_del();
	test_route_add();
	test_route_del_nexthop();
	test_route_del_again();
	test_route_del_nexthop_again();
	test_populate_nbr_cache();
	test_route_add_many();
	test_route_del_many();
	test_route_lifetime();
	test_route_preference();
}

ZTEST_SUITE(route_test_suite, NULL, NULL, NULL, NULL, NULL);

#if defined(CONFIG_NET_L2_ETHERNET) && !defined(CONFIG_ETH_DRIVER)

/*
 * Packet-forwarding tests for net_route_packet(). These require a real
 * link-layer (Ethernet) because the DUMMY L2 used above skips LL handling.
 */

static struct net_in6_addr ul_nexthop = { { { 0x20, 0x01, 0x0d, 0xb8, 0, 0, 0, 0,
					     0, 0, 0, 0, 0, 0, 0, 0x02 } } };
static struct net_in6_addr rp_nexthop = { { { 0x20, 0x01, 0x0d, 0xb8, 0, 0, 0, 0,
					     0, 0, 0, 0, 0, 0, 0, 0x03 } } };
static struct net_in6_addr rp_src = { { { 0x20, 0x01, 0x0d, 0xb8, 0, 0, 0, 0,
				       0, 0, 0, 0, 0, 0, 0, 0x10 } } };
static struct net_in6_addr rp_dst = { { { 0x20, 0x01, 0x0d, 0xb8, 0, 0, 0, 0,
				       0, 0, 0, 0, 0, 0, 0, 0x99 } } };

struct route_eth_capture {
	bool armed;
	bool done;
	uint8_t ll_src[sizeof(struct net_eth_addr)];
	struct net_if *iface;
};

static struct route_eth_capture route_eth_tx_capture;

K_SEM_DEFINE(route_eth_send_sem, 0, 1);

struct route_eth_test {
	uint8_t mac_addr[sizeof(struct net_eth_addr)];
	struct net_linkaddr ll_addr;
};

static struct route_eth_test route_eth_data;

static uint8_t *route_eth_get_mac(const struct device *dev)
{
	struct route_eth_test *data = dev->data;

	if (data->mac_addr[2] == 0x00) {
		data->mac_addr[0] = 0x00;
		data->mac_addr[1] = 0x00;
		data->mac_addr[2] = 0x5E;
		data->mac_addr[3] = 0x00;
		data->mac_addr[4] = 0x53;
		data->mac_addr[5] = sys_rand8_get();
	}

	memcpy(data->ll_addr.addr, data->mac_addr, sizeof(data->mac_addr));
	data->ll_addr.len = sizeof(data->mac_addr);

	return data->mac_addr;
}

static void route_eth_iface_init(struct net_if *iface)
{
	uint8_t *mac = route_eth_get_mac(net_if_get_device(iface));

	net_if_set_link_addr(iface, mac, sizeof(struct net_eth_addr),
			     NET_LINK_ETHERNET);
	net_if_flag_set(iface, NET_IF_IPV6_NO_ND);
}

static int route_eth_send(const struct device *dev, struct net_pkt *pkt)
{
	ARG_UNUSED(dev);

	if (route_eth_tx_capture.armed && pkt != NULL) {
		struct net_linkaddr *ll_src = net_pkt_lladdr_src(pkt);

		if (ll_src != NULL && ll_src->len > 0) {
			memcpy(route_eth_tx_capture.ll_src, ll_src->addr, ll_src->len);
			route_eth_tx_capture.iface = net_pkt_iface(pkt);
			route_eth_tx_capture.done = true;
			k_sem_give(&route_eth_send_sem);
		}
	}

	return 0;
}

static struct ethernet_api route_eth_if_api = {
	.iface_api.init = route_eth_iface_init,
	.send = route_eth_send,
};

#define _ROUTE_ETH_L2_LAYER ETHERNET_L2
#define _ROUTE_ETH_L2_CTX_TYPE NET_L2_GET_CTX_TYPE(ETHERNET_L2)

NET_DEVICE_INIT_INSTANCE(route_eth_test, "route_eth", eth0,
			 net_route_dev_init, NULL,
			 &route_eth_data, NULL,
			 CONFIG_KERNEL_INIT_PRIORITY_DEFAULT,
			 &route_eth_if_api, _ROUTE_ETH_L2_LAYER,
			 _ROUTE_ETH_L2_CTX_TYPE, 128);

/*
 * An Ethernet nexthop neighbor with NET_NBR_LLADDR_UNKNOWN must make
 * net_route_packet() return -ESRCH instead of calling net_nbr_get_lladdr()
 * (which asserts on idx 0xff).
 */
ZTEST(route_packet_suite, test_route_unknown_ll_nbr)
{
	struct net_if *eth_if;
	struct net_nbr *nbr;
	struct net_pkt *pkt;
	int ret;

	eth_if = net_if_get_first_by_type(&NET_L2_GET_NAME(ETHERNET));
	zassert_not_null(eth_if, "Ethernet test iface missing");

	nbr = net_ipv6_nbr_add(eth_if, &ul_nexthop, NULL, false,
			       NET_IPV6_NBR_STATE_INCOMPLETE);
	zassert_not_null(nbr, "Cannot seed INCOMPLETE neighbor");
	zassert_equal(nbr->idx, NET_NBR_LLADDR_UNKNOWN,
		       "INCOMPLETE neighbor should have unknown LL idx");

	pkt = net_pkt_alloc_with_buffer(eth_if, 64, NET_AF_INET6,
					NET_IPPROTO_ICMPV6, K_FOREVER);
	zassert_not_null(pkt, "Cannot allocate test packet");

	net_linkaddr_copy(net_pkt_lladdr_src(pkt), net_if_get_link_addr(eth_if));

	ret = net_route_packet(pkt, &ul_nexthop);
	zassert_equal(ret, -ESRCH,
		      "net_route_packet must fail when neighbor LL is unknown");

	net_pkt_unref(pkt);
	net_ipv6_nbr_rm(eth_if, &ul_nexthop);
}

/*
 * net_route_packet() must set the link-layer source address from the
 * outbound nexthop iface, not the inbound iface, on cross-L2 forward.
 */
ZTEST(route_packet_suite, test_route_outbound_ll_src)
{
	struct net_if *inbound_if = net_if_get_first_by_type(&NET_L2_GET_NAME(DUMMY));
	struct net_if *outbound_if = net_if_get_first_by_type(&NET_L2_GET_NAME(ETHERNET));
	const struct net_linkaddr *outbound_ll;
	struct net_linkaddr inbound_ll;
	struct net_linkaddr nbr_ll;
	struct net_nbr *nbr;
	struct net_pkt *pkt;
	int ret;

	zassert_not_null(inbound_if, "Inbound iface missing");
	zassert_not_null(outbound_if, "Outbound iface missing");

	outbound_ll = net_if_get_link_addr(outbound_if);
	zassert_not_null(outbound_ll, "Outbound link address missing");

	inbound_ll.type = NET_LINK_ETHERNET;
	inbound_ll.len = sizeof(struct net_eth_addr);
	inbound_ll.addr[0] = 0x00;
	inbound_ll.addr[1] = 0x00;
	inbound_ll.addr[2] = 0x5E;
	inbound_ll.addr[3] = 0x00;
	inbound_ll.addr[4] = 0x53;
	inbound_ll.addr[5] = 0x01;

	zassert_false(memcmp(inbound_ll.addr, outbound_ll->addr, outbound_ll->len) == 0,
		      "Inbound and outbound MACs must differ");

	nbr_ll.len = outbound_ll->len;
	nbr_ll.type = NET_LINK_ETHERNET;
	nbr_ll.addr[0] = 0x02;
	nbr_ll.addr[1] = 0x00;
	nbr_ll.addr[2] = 0x5E;
	nbr_ll.addr[3] = 0x00;
	nbr_ll.addr[4] = 0x53;
	nbr_ll.addr[5] = 0x42;

	nbr = net_ipv6_nbr_add(outbound_if, &rp_nexthop, &nbr_ll, false,
			       NET_IPV6_NBR_STATE_REACHABLE);
	zassert_not_null(nbr, "Cannot seed outbound neighbor");

	route_eth_tx_capture.armed = true;
	route_eth_tx_capture.done = false;

	pkt = net_pkt_alloc_with_buffer(inbound_if, 64, NET_AF_INET6,
					NET_IPPROTO_ICMPV6, K_FOREVER);
	zassert_not_null(pkt, "Cannot allocate test packet");

	net_pkt_set_orig_iface(pkt, inbound_if);
	zassert_ok(net_ipv6_create(pkt, &rp_src, &rp_dst),
		   "Cannot create IPv6 header");
	zassert_ok(net_icmpv6_create(pkt, NET_ICMPV6_ECHO_REQUEST, 0),
		   "Cannot create ICMPv6 header");

	uint8_t echo_data[4] = { 0x00, 0x01, 0x00, 0x01 };

	zassert_ok(net_pkt_write(pkt, echo_data, sizeof(echo_data)),
		   "Cannot write ICMPv6 payload");
	net_ipv6_finalize(pkt, NET_IPPROTO_ICMPV6);
	net_pkt_set_ll_proto_type(pkt, NET_ETH_PTYPE_IPV6);

	net_linkaddr_copy(net_pkt_lladdr_src(pkt), &inbound_ll);

	ret = net_route_packet(pkt, &rp_nexthop);
	zassert_ok(ret, "net_route_packet failed (%d)", ret);
	zassert_ok(k_sem_take(&route_eth_send_sem, K_SECONDS(1)),
		   "Timed out waiting for outbound send");
	zassert_true(route_eth_tx_capture.done,
		     "Packet should be sent on outbound nexthop iface");
	zassert_equal_ptr(route_eth_tx_capture.iface, outbound_if,
			  "Packet should be sent on outbound iface");
	zassert_mem_equal(route_eth_tx_capture.ll_src, outbound_ll->addr, outbound_ll->len,
			  "LL src should be outbound MAC, not inbound");
	zassert_false(memcmp(route_eth_tx_capture.ll_src, inbound_ll.addr,
			     inbound_ll.len) == 0,
		      "LL src must not stay as inbound MAC");

	route_eth_tx_capture.armed = false;
	net_ipv6_nbr_rm(outbound_if, &rp_nexthop);
}

ZTEST_SUITE(route_packet_suite, NULL, NULL, NULL, NULL, NULL);

#endif /* CONFIG_NET_L2_ETHERNET && !CONFIG_ETH_DRIVER */
```
